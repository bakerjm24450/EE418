## blinky/sdkconfig.defaults.esp32
```kconfig
#
# Serial flasher config
#
CONFIG_ESPTOOLPY_FLASHSIZE_4MB=y
CONFIG_ESPTOOLPY_FLASHSIZE="4MB"

#
# Application Level Tracing
#
CONFIG_APPTRACE_DEST_NONE=y
CONFIG_APPTRACE_DEST_UART=y
CONFIG_APPTRACE_DEST_UART_NOUSB=y
CONFIG_APPTRACE_DEST_UART1=y
CONFIG_APPTRACE_UART_TX_GPIO=12
CONFIG_APPTRACE_UART_RX_GPIO=13
CONFIG_APPTRACE_UART_BAUDRATE=1000000
CONFIG_APPTRACE_UART_RX_BUFF_SIZE=128
CONFIG_APPTRACE_UART_TX_BUFF_SIZE=4096
CONFIG_APPTRACE_UART_TX_MSG_SIZE=128
CONFIG_APPTRACE_UART_TASK_PRIO=1
CONFIG_APPTRACE_ENABLE=y
CONFIG_APPTRACE_LOCK_ENABLE=y
CONFIG_APPTRACE_ONPANIC_HOST_FLUSH_TMO=-1
CONFIG_APPTRACE_POSTMORTEM_FLUSH_THRESH=0
```

## project2/main/Kconfig.projbuild
```kconfig
menu "EE 418 Project Configuration"

    config DHT22_GPIO
        int "DHT22 GPIO Pin"
        help
            GPIO pin used for communication with DHT22 sensor
            
    config ESP_WIFI_SSID
        string "WiFi SSID"
        default "Replace with given SSID"
        help
            SSID (network name) to connect to

    config ESP_WIFI_PASSWORD
        string "WiFi Password"
        default "Replace with given password"
        help
            WiFi password (WPA2)

    config ESP_WIFI_MAX_RETRIES
        int "Maximum number of retry attempts"
        default 30
        help
            Maximum number of attempts to retry connecting to WiFi network
    config ESP_HOSTNAME
        string "mDNS Hostname"
        default "esp32-yournamehere"
        help
            Unique network hostname for this ESP32
            
endmenu
```

## project2/sdkconfig.defaults.esp32s3
```kconfig
#
# Serial flasher config
#
CONFIG_ESPTOOLPY_FLASHSIZE_4MB=y
CONFIG_ESPTOOLPY_FLASHSIZE="4MB"

#
# Application Level Tracing
#
CONFIG_APPTRACE_DEST_NONE=y
CONFIG_APPTRACE_DEST_UART=y
CONFIG_APPTRACE_DEST_USB_CDC=y
CONFIG_APPTRACE_UART_BAUDRATE=1000000
CONFIG_APPTRACE_UART_RX_BUFF_SIZE=128
CONFIG_APPTRACE_UART_TX_BUFF_SIZE=4096
CONFIG_APPTRACE_UART_TX_MSG_SIZE=128
CONFIG_APPTRACE_UART_TASK_PRIO=1
CONFIG_APPTRACE_ENABLE=y
CONFIG_APPTRACE_LOCK_ENABLE=y
CONFIG_APPTRACE_ONPANIC_HOST_FLUSH_TMO=-1
CONFIG_APPTRACE_POSTMORTEM_FLUSH_THRESH=0
```

## project3/sdkconfig.defaults.esp32s3
```kconfig
#
# Serial flasher config
#
CONFIG_ESPTOOLPY_FLASHSIZE_4MB=y
CONFIG_ESPTOOLPY_FLASHSIZE="4MB"

#
# Application Level Tracing
#
CONFIG_APPTRACE_DEST_NONE=y
CONFIG_APPTRACE_DEST_UART=y
CONFIG_APPTRACE_DEST_USB_CDC=y
CONFIG_APPTRACE_UART_BAUDRATE=1000000
CONFIG_APPTRACE_UART_RX_BUFF_SIZE=128
CONFIG_APPTRACE_UART_TX_BUFF_SIZE=4096
CONFIG_APPTRACE_UART_TX_MSG_SIZE=128
CONFIG_APPTRACE_UART_TASK_PRIO=1
CONFIG_APPTRACE_ENABLE=y
CONFIG_APPTRACE_LOCK_ENABLE=y
CONFIG_APPTRACE_ONPANIC_HOST_FLUSH_TMO=-1
CONFIG_APPTRACE_POSTMORTEM_FLUSH_THRESH=0

#
# SPI configuration for HX8357D display
#
CONFIG_LCD_HOST=SPI2_HOST
CONFIG_SCLK_GPIO=36
CONFIG_MOSI_GPIO=35
CONFIG_MISO_GPIO=37
CONFIG_DC_GPIO=10
CONFIG_CS_GPIO=9
CONFIG_TOUCH_CS_GPIO=6
CONFIG_SD_CS_GPIO=5
```

## project6/sdkconfig.defaults
```kconfig
# FreeRTOS
# Kernel
CONFIG_FREERTOS_HZ=1000

# Log level
CONFIG_LOG_MAXIMUM_LEVEL_DEBUG=y
CONFIG_LOG_MAXIMUM_LEVEL=4

# Need space for large app
CONFIG_PARTITION_TABLE_SINGLE_APP_LARGE=y
CONFIG_PARTITION_TABLE_CUSTOM_FILENAME="partitions.csv"
CONFIG_PARTITION_TABLE_FILENAME="partitions_singleapp_large.csv"
CONFIG_PARTITION_TABLE_OFFSET=0x8000
CONFIG_PARTITION_TABLE_MD5=y

# SPI configuration
CONFIG_SPI_MASTER_ISR_IN_IRAM=y

# LVGL settings
CONFIG_LV_CONF_SKIP=y
CONFIG_LV_COLOR_DEPTH_16=y
CONFIG_LV_COLOR_DEPTH=16
CONFIG_LV_USE_BUILTIN_MALLOC=y
CONFIG_LV_USE_BUILTIN_STRING=y
CONFIG_LV_USE_CLIB_SPRINTF=y
CONFIG_LV_OS_FREERTOS=y
CONFIG_LV_USE_OS=2
CONFIG_LV_USE_FREERTOS_TASK_NOTIFY=y
CONFIG_LV_DRAW_SW_SUPPORT_RGB565=y
CONFIG_LV_USE_ASSERT_NULL=y
CONFIG_LV_USE_ASSERT_MALLOC=y
CONFIG_LV_ASSERT_HANDLER_INCLUDE="assert.h"
CONFIG_LV_FONT_MONTSERRAT_14=y
CONFIG_LV_FONT_MONTSERRAT_18=y
CONFIG_LV_FONT_MONTSERRAT_24=y
CONFIG_LV_FONT_MONTSERRAT_48=y
CONFIG_LV_FONT_DEFAULT_MONTSERRAT_14=y
CONFIG_LV_USE_FONT_PLACEHOLDER=y
CONFIG_LV_TXT_ENC_UTF8=yCONFIG_LV_TXT_BREAK_CHARS=" ,.;:-_)}"
CONFIG_LV_TXT_LINE_BREAK_LONG_LEN=0
CONFIG_LV_WIDGETS_HAS_DEFAULT_VALUE=y
CONFIG_LV_USE_ANIMIMG=y
CONFIG_LV_USE_BUTTON=y
CONFIG_LV_USE_CHART=y
CONFIG_LV_USE_IMAGE=y
CONFIG_LV_USE_IMAGEBUTTON=y
CONFIG_LV_USE_LABEL=y
CONFIG_LV_LABEL_LONG_TXT_HINT=y
CONFIG_LV_LABEL_WAIT_CHAR_COUNT=3
CONFIG_LV_USE_LINE=y
CONFIG_LV_USE_SCALE=y
CONFIG_LV_USE_SPAN=y
CONFIG_LV_SPAN_SNIPPET_STACK_SIZE=64
CONFIG_LV_USE_TABLE=y
CONFIG_LV_USE_TABVIEW=y
CONFIG_LV_USE_TILEVIEW=y
CONFIG_LV_USE_WIN=y
CONFIG_LV_USE_THEME_DEFAULT=y
CONFIG_LV_THEME_DEFAULT_GROW=y
CONFIG_LV_THEME_DEFAULT_TRANSITION_TIME=80
CONFIG_LV_USE_THEME_SIMPLE=y
CONFIG_LV_USE_FLEX=y
```

## project7/main/Kconfig.projbuild
```kconfig
menu "EE 418 Project Configuration"

    config ESP_WIFI_SSID
        string "WiFi SSID"
        default "Replace with given SSID"
        help
            SSID (network name) to connect to

    config ESP_WIFI_PASSWORD
        string "WiFi Password"
        default "Replace with given password"
        help
            WiFi password (WPA2)

    config ESP_WIFI_MAX_RETRIES
        int "Maximum number of retry attempts"
        default 30
        help
            Maximum number of attempts to retry connecting to WiFi network
    config ESP_HOSTNAME
        string "mDNS Hostname"
        default "esp32-yournamehere"
        help
            Unique network hostname for this ESP32

    config DHT22_GPIO
       int "DHT22 GPIO Pin"
        help
            GPIO pin used for communication with DHT22 sensor
                    
    config THERMOSTAT_GPIO
        int "Thermostat GPIO Pin"
        help
            GPIO pin used by thermostat for controlling heat
            
    config SCLK_GPIO
        int "SPI SCLK GPIO Pin"
        help 
            GPIO pin used as SPI SCLK

    config MOSI_GPIO
        int "SPI MOSI GPIO Pin"
        help
            GPIO pin used as SPI MOSI
        
    config MISO_GPIO
        int "SPI MISO GPIO Pin"
        help
            GPIO pin used as SPI MISO
     
    config DC_GPIO
        int "SPI DC GPIO Pin"
        help
            GPIO pin used as SPI DC

    config CS_GPIO
        int "LCD CS GPIO Pin"
        help
            GPIO pin used as LCD CS
                
    config TOUCH_CS_GPIO
        int "Touchscreen CS GPIO Pin"
        help
            GPIO pin used as touchscreen CS
                
    config SD_CS_GPIO
        int "SD card CS GPIO Pin"
        help
            GPIO pin used as SD card CS
                                
        
endmenu
```

## project7/sdkconfig.defaults.esp32
```kconfig
#
# Serial flasher config
#
CONFIG_ESPTOOLPY_FLASHSIZE_4MB=y
CONFIG_ESPTOOLPY_FLASHSIZE="4MB"

#
# Application Level Tracing
#
CONFIG_APPTRACE_DEST_NONE=y
CONFIG_APPTRACE_DEST_UART=y
CONFIG_APPTRACE_DEST_UART_NOUSB=y
CONFIG_APPTRACE_DEST_UART1=y
CONFIG_APPTRACE_UART_TX_GPIO=12
CONFIG_APPTRACE_UART_RX_GPIO=13
CONFIG_APPTRACE_UART_BAUDRATE=1000000
CONFIG_APPTRACE_UART_RX_BUFF_SIZE=128
CONFIG_APPTRACE_UART_TX_BUFF_SIZE=4096
CONFIG_APPTRACE_UART_TX_MSG_SIZE=128
CONFIG_APPTRACE_UART_TASK_PRIO=1
CONFIG_APPTRACE_ENABLE=y
CONFIG_APPTRACE_LOCK_ENABLE=y
CONFIG_APPTRACE_ONPANIC_HOST_FLUSH_TMO=-1
CONFIG_APPTRACE_POSTMORTEM_FLUSH_THRESH=0

#
# SPI configuration for HX8357D display
#
CONFIG_LCD_HOST=SPI2_HOST
CONFIG_SCLK_GPIO=5
CONFIG_MOSI_GPIO=18
CONFIG_MISO_GPIO=19
CONFIG_DC_GPIO=33
CONFIG_CS_GPIO=15
CONFIG_TOUCH_CS_GPIO=32
CONFIG_SD_CS_GPIO=14
```
