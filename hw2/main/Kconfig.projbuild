## hw2/main/Kconfig.projbuild
```kconfig
menu "EE 418 HW 2 Configuration"

     config LED_GPIO
        int "LED GPIO Pin"
        default 18
        help
            GPIO pin used for LED

endmenu
```

## hw3/main/Kconfig.projbuild
```kconfig
menu "EE 418 HW 3 Configuration"

     config OUTPUT_GPIO
        int "Output GPIO Pin"
        default 18
        help
            GPIO pin used for output

    config INPUT_GPIO
        int "Input GPIO Pin"
        default 5
        help
            GPIO pin used for input

endmenu
```

## hw6/main/Kconfig.projbuild
```kconfig
menu "EE 418 HW 6 Configuration"

     config RED_LED_GPIO
        int "Red LED GPIO Pin"
        default 18
        help
            GPIO pin used for red LED

    config GREEN_LED_GPIO
        int "Green LED GPIO Pin"
        default 17
        help
            GPIO pin used for green LED

endmenu
```

## project1/main/Kconfig.projbuild
```kconfig
menu "EE 418 Project 1 Configuration"

    config DHT_GPIO
        int "DHT Sensor GPIO Pin"
        default 16
        help
            GPIO pin connected to the DHT sensor.

     config LED_GPIO
        int "(Optional) LED GPIO Pin"
        default 18
        help
            Optional GPIO pin used for LED (useful for debugging).

endmenu
```

## project1/sdkconfig.defaults
```kconfig
# FreeRTOS
# Kernel
CONFIG_FREERTOS_HZ=1000

# Log level
CONFIG_LOG_MAXIMUM_LEVEL_DEBUG=y
CONFIG_LOG_MAXIMUM_LEVEL=4

# Need space for large app
CONFIG_PARTITION_TABLE_SINGLE_APP_LARGE=y
CONFIG_PARTITION_TABLE_CUSTOM_FILENAME="partitions.csv"
CONFIG_PARTITION_TABLE_FILENAME="partitions_singleapp_large.csv"
CONFIG_PARTITION_TABLE_OFFSET=0x8000
CONFIG_PARTITION_TABLE_MD5=y
```
